// Copyright 2021 Manna Harbour
// https://github.com/manna-harbour/miryoku

#include "../miryoku/custom_config.h"
#include "../miryoku/mapping/36/minidox.h"
#include "../miryoku/miryoku.dtsi"

/ {
    conditional_layers {
        compatible = "zmk,conditional-layers";
        tri_layer {
            if-layers = <U_NAV U_MOUSE>;
            then-layer = <U_HFN>;
        };
    };
};